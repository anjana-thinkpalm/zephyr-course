## l5-task1/boards/renesas/l5_ra6m4/Kconfig.l5_ra6m4
```kconfig
# SPDX-License-Identifier: Apache-2.0

config BOARD_L5_RA6M4
    select SOC_R7FA6M4AF3CFB
```

## l5-task1/boards/renesas/l5_ra6m4/board.yml
```yaml
board:
  name: l5_ra6m4
  full_name: L5 Custom RA6M4 Board
  vendor: renesas
  socs:
    - name: r7fa6m4af3cfb
```

## l5-task2/boards/renesas/l5_task2_ra6m4/board.yml
```yaml
board:
  name: l5_task2_ra6m4
  full_name: L5 Task 2 Custom RA6M4 Board
  vendor: renesas
  socs:
    - name: r7fa6m4af3cfb
```

## l6-task2/dts/bindings/sensor/renesas,led-sensor.yaml
```yaml
description: Simple GPIO LED sensor driver

compatible: "renesas,led-sensor"

include: base.yaml

properties:
  gpios:
    type: phandle-array
    required: true
    description: GPIO connected to the onboard LED
```

## l7-task2/drivers/led_sensor/Kconfig
```kconfig
config LED_SENSOR
    bool "GPIO LED sensor driver"
    depends on GPIO
    help
      Enable the simple GPIO LED sensor driver.
```
