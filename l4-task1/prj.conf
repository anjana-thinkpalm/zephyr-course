## CMakeLists.txt
```
cmake_minimum_required(VERSION 3.20.0)

find_package(Zephyr REQUIRED HINTS $ENV{ZEPHYR_BASE})

project(l4_task1)

target_sources(app PRIVATE
    src/main.c
)
```

## Kconfig
```
menu "Application Configuration"

config APP_HEARTBEAT_PERIOD_MS
    int "Heartbeat LED period (ms)"
    default 500
    range 100 2000
    help
      Heartbeat LED blink period in milliseconds.

endmenu
```

## prj.conf
```kconfig
CONFIG_GPIO=y
CONFIG_APP_HEARTBEAT_PERIOD_MS=500
```

## src/main.c
```c
#include <zephyr/kernel.h>
#include <zephyr/device.h>
#include <zephyr/drivers/gpio.h>
#include <zephyr/devicetree.h>

#define APP_LED_NODE DT_ALIAS(app_led)

#if !DT_NODE_HAS_STATUS(APP_LED_NODE, okay)
#error "app-led alias is not defined or LED is not available"
#endif

static const struct gpio_dt_spec heartbeat_led =
    GPIO_DT_SPEC_GET(APP_LED_NODE, gpios);

int main(void)
{
    int ret;

    if (!gpio_is_ready_dt(&heartbeat_led)) {
        return 0;
    }

    ret = gpio_pin_configure_dt(&heartbeat_led, GPIO_OUTPUT_INACTIVE);
    if (ret < 0) {
        return 0;
    }

    while (1) {
        gpio_pin_toggle_dt(&heartbeat_led);

        k_msleep(CONFIG_APP_HEARTBEAT_PERIOD_MS);
    }

    return 0;
}
```
