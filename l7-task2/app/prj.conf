## CMakeLists.txt
```
cmake_minimum_required(VERSION 3.20.0)

list(APPEND DTS_ROOT ${CMAKE_CURRENT_LIST_DIR}/..)

find_package(Zephyr REQUIRED HINTS $ENV{ZEPHYR_BASE})
project(l7_task2_sensor_set_shell)

target_include_directories(app PRIVATE
    ${CMAKE_CURRENT_LIST_DIR}/../drivers/led_sensor
)

target_sources(app PRIVATE
    src/main.c
    src/sensor_shell.c
    ${CMAKE_CURRENT_LIST_DIR}/../drivers/led_sensor/led_sensor.c
)
```

## prj.conf
```kconfig
CONFIG_GPIO=y
CONFIG_SENSOR=y
CONFIG_PRINTK=y
CONFIG_SHELL=y
```

## src/main.c
```c
/*
 * SPDX-License-Identifier: Apache-2.0
 *
 * L7 Task 2: blink the LED through the sensor API. The interval is re-read
 * every cycle so `sensorroot set <ms>` takes effect immediately.
 */

#include <zephyr/kernel.h>
#include <zephyr/device.h>
#include <zephyr/drivers/sensor.h>
#include <zephyr/sys/printk.h>

#include "led_sensor.h"

int main(void)
{
	const struct device *led_sensor =
		DEVICE_DT_GET(DT_NODELABEL(led_sensor0));
	struct sensor_value value;
	uint32_t interval_ms = 0;
	int ret;

	if (!device_is_ready(led_sensor)) {
		printk("LED sensor device is not ready\n");
		return 0;
	}

	printk("LED sensor ready. Try: sensorroot set <100-10000> | get\n");

	while (1) {
		ret = led_sensor_get_blink_interval(led_sensor, &interval_ms);
		if (ret < 0) {
			printk("Failed to get blink interval: %d\n", ret);
			k_sleep(K_SECONDS(1));
			continue;
		}

		/* sensor_sample_fetch() turns the LED ON. */
		ret = sensor_sample_fetch(led_sensor);
		if (ret < 0) {
			printk("Sensor sample fetch failed: %d\n", ret);
			k_sleep(K_SECONDS(1));
			continue;
		}
		k_sleep(K_MSEC(interval_ms));

		/* sensor_channel_get() turns the LED OFF. */
		ret = sensor_channel_get(led_sensor, SENSOR_CHAN_ALL, &value);
		if (ret < 0) {
			printk("Sensor channel get failed: %d\n", ret);
			k_sleep(K_SECONDS(1));
			continue;
		}
		k_sleep(K_MSEC(interval_ms));
	}

	return 0;
}
```

## src/sensor_shell.c
```c
/*
 * SPDX-License-Identifier: Apache-2.0
 *
 * sensorroot shell command exposing the LED sensor's custom extension API.
 *
 *   sensorroot set <ms>  -> led_sensor_set_blink_interval()  (100..10000 ms)
 *   sensorroot get       -> led_sensor_get_blink_interval()
 */

#include <errno.h>
#include <stdlib.h>
#include <ctype.h>
#include <zephyr/kernel.h>
#include <zephyr/device.h>
#include <zephyr/shell/shell.h>

#include "led_sensor.h"

#define BLINK_INTERVAL_MIN_MS 100U
#define BLINK_INTERVAL_MAX_MS 10000U

static const struct device *const led_sensor =
	DEVICE_DT_GET(DT_NODELABEL(led_sensor0));

static int cmd_set(const struct shell *sh, size_t argc, char **argv)
{
	char *end;
	unsigned long value;
	int ret;

	/* SHELL_CMD_ARG already enforces this; kept as a safety net. */
	if (argc != 2) {
		shell_error(sh, "Missing argument. Usage: sensorroot set <%u-%u ms>",
			    BLINK_INTERVAL_MIN_MS, BLINK_INTERVAL_MAX_MS);
		return -EINVAL;
	}

	/* strtoul() accepts a leading '-' or whitespace, so require a digit. */
	if (!isdigit((unsigned char)argv[1][0])) {
		shell_error(sh, "Invalid value '%s': expected a number in ms", argv[1]);
		return -EINVAL;
	}

	errno = 0;
	value = strtoul(argv[1], &end, 10);
	if (errno == ERANGE || *end != '\0') {
		shell_error(sh, "Invalid value '%s': expected a number in ms", argv[1]);
		return -EINVAL;
	}

	if (value < BLINK_INTERVAL_MIN_MS || value > BLINK_INTERVAL_MAX_MS) {
		shell_error(sh, "Value %lu out of range (%u-%u ms)", value,
			    BLINK_INTERVAL_MIN_MS, BLINK_INTERVAL_MAX_MS);
		return -ERANGE;
	}

	ret = led_sensor_set_blink_interval(led_sensor, (uint32_t)value);
	if (ret < 0) {
		shell_error(sh, "led_sensor_set_blink_interval failed: %d", ret);
		return ret;
	}

	shell_print(sh, "Blink interval set to %lu ms", value);
	return 0;
}

static int cmd_get(const struct shell *sh, size_t argc, char **argv)
{
	uint32_t interval_ms;
	int ret;

	ARG_UNUSED(argc);
	ARG_UNUSED(argv);

	ret = led_sensor_get_blink_interval(led_sensor, &interval_ms);
	if (ret < 0) {
		shell_error(sh, "led_sensor_get_blink_interval failed: %d", ret);
		return ret;
	}

	shell_print(sh, "Blink interval: %u ms", interval_ms);
	return 0;
}

SHELL_STATIC_SUBCMD_SET_CREATE(sensorroot_cmds,
	/* mandatory = 2 (command + 1 argument), optional = 0 -> exactly one arg */
	SHELL_CMD_ARG(set, NULL, "Set blink interval in ms (100-10000)\n"
			  "Usage: sensorroot set <ms>", cmd_set, 2, 0),
	SHELL_CMD_ARG(get, NULL, "Show current blink interval", cmd_get, 1, 0),
	SHELL_SUBCMD_SET_END
);

SHELL_CMD_REGISTER(sensorroot, &sensorroot_cmds, "LED sensor commands", NULL);
```
