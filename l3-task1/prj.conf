## CMakeLists.txt
```
cmake_minimum_required(VERSION 3.20.0)

find_package(Zephyr REQUIRED HINTS $ENV{ZEPHYR_BASE})
project(led_kconfig)

target_sources(app PRIVATE src/main.c)
```

## Kconfig
```
menuconfig LED_SUBSYSTEM
    bool "LED Subsystem"
    default y

if LED_SUBSYSTEM

choice LED_BLINK_SLEEP_TIME
    prompt "LED blink sleep time"
    default LED_SLEEP_MEDIUM

config LED_SLEEP_SHORT
    bool "500ms (fast)"

config LED_SLEEP_MEDIUM
    bool "1s (medium)"

config LED_SLEEP_LONG
    bool "2s (slow)"

endchoice

config LED_BLINK_SLEEP_MS
    int
    default 500 if LED_SLEEP_SHORT
    default 1000 if LED_SLEEP_MEDIUM
    default 2000 if LED_SLEEP_LONG

menuconfig LED_ADVANCED_SETTINGS
    bool "Advanced LED settings"

if LED_ADVANCED_SETTINGS

config LED_BRIGHTNESS
    int "LED brightness (0-100)"
    range 0 100
    default 100

config LED_FADE_DURATION
    int "LED fade duration (ms)"
    range 0 5000
    default 500

menu "Expert settings"
    visible if LED_ADVANCED_SETTINGS

config LED_DEBUGGING
    bool "Enable LED debugging"

config LED_CUSTOM_BLINK
    bool "Custom blink pattern"

endmenu

endif # LED_ADVANCED_SETTINGS

endif # LED_SUBSYSTEM
```

## prj.conf
```kconfig
CONFIG_LED_SUBSYSTEM=y
CONFIG_LED_SLEEP_MEDIUM=y
```

## src/main.c
```c
#include <zephyr/kernel.h>
#include <zephyr/sys/printk.h>

int main(void)
{
    printk("L3 Task 1 - Kconfig LED Subsystem\n");

    while (1) {
        k_sleep(K_MSEC(CONFIG_LED_BLINK_SLEEP_MS));
    }

    return 0;
}
```
