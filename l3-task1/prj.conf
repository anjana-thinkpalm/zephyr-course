## CMakeLists.txt
```
cmake_minimum_required(VERSION 3.20.0)

find_package(Zephyr REQUIRED HINTS $ENV{ZEPHYR_BASE})
project(led_kconfig)

target_sources(app PRIVATE src/main.c)
```

## Kconfig
```
mainmenu "LED Configuration"

menuconfig LED_SUBSYSTEM
    bool "LED Subsystem"
    default y
    help
      Enable the LED subsystem.

if LED_SUBSYSTEM

choice LED_BLINK_SLEEP_TIME
    prompt "LED blink sleep time"
    default LED_BLINK_MEDIUM

config LED_BLINK_FAST
    bool "500ms (fast)"

config LED_BLINK_MEDIUM
    bool "1s (medium)"

config LED_BLINK_SLOW
    bool "2s (slow)"

endchoice

menuconfig ADVANCED_LED_SETTINGS
    bool "Advanced LED settings"
    default n
    help
      Enable advanced LED settings.

if ADVANCED_LED_SETTINGS

config LED_BRIGHTNESS
    int "LED brightness (0-100)"
    range 0 100
    default 100

config LED_FADE_DURATION
    int "LED fade duration (ms)"
    range 0 10000
    default 500

menu "Expert settings"

config LED_DEBUG
    bool "Enable LED debugging"
    default n

config LED_CUSTOM_BLINK_PATTERN
    bool "Custom blink pattern"
    default n

endmenu

endif

endif
```

## prj.conf
```kconfig
CONFIG_LED_SUBSYSTEM=y
CONFIG_LED_BLINK_MEDIUM=y
```

## src/main.c
```c
#include <zephyr/kernel.h>
#include <zephyr/sys/printk.h>

int main(void)
{
    printk("LED Kconfig application started\n");

#if defined(CONFIG_LED_SUBSYSTEM)
    printk("LED Subsystem: Enabled\n");
#endif

#if defined(CONFIG_LED_BLINK_FAST)
    printk("LED Blink Interval: 500 ms\n");
#elif defined(CONFIG_LED_BLINK_MEDIUM)
    printk("LED Blink Interval: 1000 ms\n");
#elif defined(CONFIG_LED_BLINK_SLOW)
    printk("LED Blink Interval: 2000 ms\n");
#endif

#if defined(CONFIG_ADVANCED_LED_SETTINGS)
    printk("Advanced LED Settings: Enabled\n");
    printk("LED Brightness: %d\n", CONFIG_LED_BRIGHTNESS);
    printk("LED Fade Duration: %d ms\n", CONFIG_LED_FADE_DURATION);
#endif

    while (1) {
        k_sleep(K_SECONDS(1));
    }

    return 0;
}
```
